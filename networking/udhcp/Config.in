## shell/Config.in
```kconfig
#
# For a description of the syntax of this configuration file,
# see scripts/kbuild/config-language.txt.
#

menu "Another Bourne-like Shell"

choice
	prompt "Choose your default shell"
	default CONFIG_FEATURE_SH_IS_NONE
	help
	  Choose a shell. The ash shell is the most bash compatible
	  and full featured one.

config CONFIG_FEATURE_SH_IS_ASH
	select CONFIG_ASH
	bool "ash"

config CONFIG_FEATURE_SH_IS_HUSH
	select CONFIG_HUSH
	bool "hush"

config CONFIG_FEATURE_SH_IS_LASH
	select CONFIG_LASH
	bool "lash"

config CONFIG_FEATURE_SH_IS_MSH
	select CONFIG_MSH
	bool "msh"

config CONFIG_FEATURE_SH_IS_NONE
	bool "none"

endchoice

config CONFIG_ASH
	bool "ash"
	default y
	help
	  Tha 'ash' shell adds about 60k in the default configuration and is
	  the most complete and most pedantically correct shell included with
	  busybox.  This shell is actually a derivative of the Debian 'dash'
	  shell (by Herbert Xu), which was created by porting the 'ash' shell
	  (written by Kenneth Almquist) from NetBSD.  

comment "Ash Shell Options"
	depends on CONFIG_ASH

config CONFIG_ASH_JOB_CONTROL
	bool "  Enable Job control"
	default y
	depends on CONFIG_ASH
	help
	  Enable job control in the ash shell.

config CONFIG_ASH_ALIAS
	bool "  Enable alias support"
	default y
	depends on CONFIG_ASH
	help
	  Enable alias support in the ash shell.

config CONFIG_ASH_MATH_SUPPORT
	bool "  Enable Posix math support"
	default y
	depends on CONFIG_ASH
	help
	  Enable math support in the ash shell.

config CONFIG_ASH_GETOPTS
	bool "  Enable getopt builtin to parse positional parameters"
	default n
	depends on CONFIG_ASH
	help
	  Enable builtin getopt in the ash shell.

config CONFIG_ASH_CMDCMD
	bool "  Enable cmdcmd to override shell builtins"
	default n
	depends on CONFIG_ASH
	help
	  Enable support for the ash 'command' builtin, which allows
	  you to run the specified command with the specified arguments,
	  even when there is an ash builtin command with the same name.

config CONFIG_ASH_MAIL
	bool "  Check for new mail on interactive shells"
	default y
	depends on CONFIG_ASH
	help
	  Enable "check for new mail" in the ash shell.

config CONFIG_ASH_OPTIMIZE_FOR_SIZE
	bool "  Optimize for size instead of speed"
	default y
	depends on CONFIG_ASH
	help
	  Compile ash for reduced size at price of speed.

config CONFIG_HUSH
	bool "hush"
	default n
	help
	  hush is a very small shell (just 18k) and it has fairly complete
	  Bourne shell grammar.  It even handles all the normal flow control
	  options such as if/then/elif/else/fi, for/in/do/done, while loops,
	  etc.

	  It does not handle case/esac, select, function, here documents ( <<
	  word ), arithmetic expansion, aliases, brace expansion, tilde
	  expansion, &> and >& redirection of stdout+stderr, etc.


config CONFIG_LASH
	bool "lash"
	default n
	help
	  lash is the very smallest shell (adds just 10k) and it is quite
	  usable as a command prompt, but it is not suitable for any but the
	  most trivial scripting (such as an initrd that calls insmod a few
	  times) since it does not understand any Bourne shell grammar.  It
	  does handle pipes, redirects, and job control though.  Adding in
	  command editing makes it a very nice lightweight command prompt.


config CONFIG_MSH
	bool "msh"
	default n
	help
	  The minix shell (adds just 30k) is quite complete and handles things
	  like for/do/done, case/esac and all the things you expect a Bourne
	  shell to do.  It is not always pedantically correct about Bourne
	  shell grammar (try running the shell testscript "tests/sh.testcases"
	  on it and compare vs bash) but for most things it works quite well.
	  It also uses only vfork, so it can be used on uClinux systems.

comment "Bourne Shell Options"
	depends on CONFIG_MSH || CONFIG_LASH || CONFIG_HUSH || CONFIG_ASH

config CONFIG_FEATURE_SH_EXTRA_QUIET
	bool "Hide message on interactive shell startup"
	default n
	depends on CONFIG_MSH || CONFIG_LASH || CONFIG_HUSH || CONFIG_ASH
	help
	  Remove the busybox introduction when starting a shell.

config CONFIG_FEATURE_SH_STANDALONE_SHELL
	bool "Standalone shell"
	default n
	depends on CONFIG_MSH || CONFIG_LASH || CONFIG_HUSH || CONFIG_ASH
	help
	  Have all the busybox commands built into the shell, creating
	  a standalone shell.

config CONFIG_FEATURE_SH_APPLETS_ALWAYS_WIN
	bool "Standalone shell -- applets always win"
	default n
	depends on CONFIG_FEATURE_SH_STANDALONE_SHELL
	help
	  Use a command builtin to the shell over one with the same name,
	  that may be on the system.

config CONFIG_FEATURE_COMMAND_EDITING
	bool "command line editing"
	default n
	depends on CONFIG_MSH || CONFIG_LASH || CONFIG_HUSH || CONFIG_ASH
	help
	  Enable command editing in shell.

config CONFIG_FEATURE_COMMAND_HISTORY
	int "history size"
	default 15
	depends on CONFIG_FEATURE_COMMAND_EDITING
	help
	  Specify command history size in shell.

config CONFIG_FEATURE_COMMAND_SAVEHISTORY
	bool "history saving"
	default n
	depends on CONFIG_ASH && CONFIG_FEATURE_COMMAND_EDITING
	help
	  Enable history saving in ash shell.

config CONFIG_FEATURE_COMMAND_TAB_COMPLETION
	bool "tab completion"
	default n
	depends on CONFIG_FEATURE_COMMAND_EDITING
	help
	  Enable tab completion in shell.

config CONFIG_FEATURE_COMMAND_USERNAME_COMPLETION
	bool "username completion"
	default n
	depends on CONFIG_FEATURE_COMMAND_TAB_COMPLETION
	help
	  Enable username completion in shell.

config CONFIG_FEATURE_SH_FANCY_PROMPT
	bool "Fancy shell prompts"
	default n
	depends on CONFIG_FEATURE_COMMAND_EDITING
	help
	  Setting this option allows for prompts to use things like \w and
	  \$ and also using escape codes.

endmenu
```

## shell/config.in
```kconfig
#
# For a description of the syntax of this configuration file,
# see scripts/kbuild/config-language.txt.
#

mainmenu_option next_comment
comment 'Bourne Shell'

choice 'Choose your default shell' \
    "ash                                    CONFIG_FEATURE_SH_IS_ASH  \
    hush                                    CONFIG_FEATURE_SH_IS_HUSH \
    lash                                    CONFIG_FEATURE_SH_IS_LASH \
    msh                                     CONFIG_FEATURE_SH_IS_MSH  \
    none                                    CONFIG_FEATURE_SH_IS_NONE"

if [ "$CONFIG_FEATURE_SH_IS_ASH" = "y" ] ; then
	define_bool CONFIG_ASH	y
fi
	
if [ "$CONFIG_FEATURE_SH_IS_HUSH" = "y" ] ; then
	define_bool CONFIG_HUSH	y
fi

if [ "$CONFIG_FEATURE_SH_IS_LASH" = "y" ] ; then
	define_bool CONFIG_LASH	y
fi

if [ "$CONFIG_FEATURE_SH_IS_MSH" = "y" ] ; then
	define_bool CONFIG_MSH	y
fi

bool 'ash'	    CONFIG_ASH
if [ "$CONFIG_ASH" = "y" ] ; then
	comment 'Ash Shell Options'
	bool 'Enable Job control'		CONFIG_ASH_JOB_CONTROL
	bool 'Enable alias support'		CONFIG_ASH_ALIAS
	bool 'Enable Posix math support'	CONFIG_ASH_MATH_SUPPORT
	bool 'Enable getopt builtin to parse positional parameters'		CONFIG_ASH_GETOPTS
	bool 'Enable cmdcmd to override shell builtins'		CONFIG_ASH_CMDCMD
	bool 'Check for new mail on interactive shells'		CONFIG_ASH_MAIL
	bool 'Optimize for size instead of speed'	CONFIG_ASH_OPTIMIZE_FOR_SIZE
	comment ''
fi

bool 'hush'	    CONFIG_HUSH
bool 'lash'	    CONFIG_LASH
bool 'msh'	    CONFIG_MSH

	
comment 'Bourne Shell Options'
bool 'command line editing'		CONFIG_FEATURE_COMMAND_EDITING
bool 'tab completion'			CONFIG_FEATURE_COMMAND_TAB_COMPLETION
bool 'username completion'		CONFIG_FEATURE_COMMAND_USERNAME_COMPLETION
bool 'Standalone shell'			CONFIG_FEATURE_SH_STANDALONE_SHELL
bool 'Standalone shell -- applets always win'	CONFIG_FEATURE_SH_APPLETS_ALWAYS_WIN
bool 'Fancy shell prompts'	CONFIG_FEATURE_SH_FANCY_PROMPT
bool 'Hide message on interactive shell startup'	CONFIG_FEATURE_SH_EXTRA_QUIET

endmenu
```

## sysdeps/linux/config.in
```kconfig
#
# For a description of the syntax of this configuration file,
# see scripts/kbuild/config-language.txt.
#
mainmenu_name "BusyBox Configuration"

mainmenu_option next_comment
comment 'BusyBox general settings'
choice 'Buffer allocation policy' \
    "use_malloc	CONFIG_FEATURE_BUFFERS_USE_MALLOC \
	 on_stack	CONFIG_FEATURE_BUFFERS_GO_ON_STACK \
	 in_bss		CONFIG_FEATURE_BUFFERS_GO_IN_BSS" use_malloc
bool 'Show verbose applet usage messages'				CONFIG_FEATURE_VERBOSE_USAGE
bool 'Support --install [-s] to install applet links at runtime' 	CONFIG_FEATURE_INSTALLER
bool 'Enable locale support (system needs locale for this to work)'	CONFIG_LOCALE_SUPPORT
bool 'Support for devfs'						CONFIG_FEATURE_DEVFS
bool 'Support compress format (.Z) in unzip operations'  		CONFIG_FEATURE_UNCOMPRESS 
bool 'Clean up all memory before exiting (usually not needed)'		CONFIG_FEATURE_CLEAN_UP
bool 'Support for SUID/SGID handling'  					CONFIG_FEATURE_SUID
if [ "$CONFIG_FEATURE_SUID" = "y" ]; then
  bool '  Runtime configuration via /etc/busybox.conf'			CONFIG_FEATURE_SUID_CONFIG
fi
endmenu

source archival/config.in
source console-tools/config.in
source editors/config.in
source fileutils/config.in
source findutils/config.in
source init/config.in
source miscutils/config.in
source modutils/config.in
source networking/config.in
source loginutils/config.in
source procps/config.in
source shell/config.in
source shellutils/config.in
source sysklogd/config.in
source textutils/config.in
source util-linux/config.in
```

## sysklogd/Config.in
```kconfig
#
# For a description of the syntax of this configuration file,
# see scripts/kbuild/config-language.txt.
#

menu "System Logging Utilities"

config CONFIG_KLOGD
	bool "klogd"
	default n
	help
	  Please submit a patch to add help text for this item.

config CONFIG_LOGGER
	bool "logger"
	default n
	help
	  Please submit a patch to add help text for this item.

config CONFIG_SYSLOGD
	bool "syslogd"
	default n
	help
	  Please submit a patch to add help text for this item.

config CONFIG_FEATURE_REMOTE_LOG
	bool "  Remote Log support"
	default n
	depends on CONFIG_SYSLOGD
	help
	  Please submit a patch to add help text for this item.

config CONFIG_FEATURE_IPC_SYSLOG
	bool "  Circular Buffer support"
	default n
	depends on CONFIG_SYSLOGD
	help
	  Please submit a patch to add help text for this item.

config CONFIG_LOGREAD
	bool "  logread"
	default y
	depends on CONFIG_FEATURE_IPC_SYSLOG
	help
	  Please submit a patch to add help text for this item.

endmenu
```

## util-linux/Config.in
```kconfig
#
# For a description of the syntax of this configuration file,
# see scripts/kbuild/config-language.txt.
#

menu "Linux System Utilities"


config CONFIG_DMESG
	bool "dmesg"
	default n
	help
	  Please submit a patch to add help text for this item.

config CONFIG_FBSET
	bool "fbset"
	default n
	help
	  Please submit a patch to add help text for this item.

config CONFIG_FEATURE_FBSET_FANCY
	bool "  Turn on extra fbset options"
	default n
	depends on CONFIG_FBSET
	help
	  Please submit a patch to add help text for this item.

config CONFIG_FEATURE_FBSET_READMODE
	bool "  Turn on fbset readmode support"
	default n
	depends on CONFIG_FBSET
	help
	  Please submit a patch to add help text for this item.

config CONFIG_FDFLUSH
	bool "fdflush"
	default n
	help
	  Please submit a patch to add help text for this item.

config CONFIG_FDISK
	bool "fdisk"
	default n
	help
	  Please submit a patch to add help text for this item.

config CONFIG_FEATURE_FDISK_WRITABLE
	bool "  Write support" 
	default y
	depends on CONFIG_FDISK
	help
	  Allow changes to be written to disk, without this you
	  will only be able to view the partition table. 

config CONFIG_FEATURE_AIX_LABEL
	bool "  Support AIX disklabels"
	default n
	depends on CONFIG_FDISK && CONFIG_FEATURE_FDISK_WRITABLE  
	help
	  Please submit a patch to add help text for this item.

config CONFIG_FEATURE_SGI_LABEL
	bool "  Support SGI disklabels"
	default n
	depends on CONFIG_FDISK && CONFIG_FEATURE_FDISK_WRITABLE
	help
	  Please submit a patch to add help text for this item.

config CONFIG_FEATURE_SUN_LABEL
	bool "  Support SUN disklabels"
	default n
 	depends on CONFIG_FDISK && CONFIG_FEATURE_FDISK_WRITABLE	
	help
	  Please submit a patch to add help text for this item.

config CONFIG_FEATURE_OSF_LABEL
	bool "  Support BSD disklabels"
	default n
	depends on CONFIG_FDISK && CONFIG_FEATURE_FDISK_WRITABLE
	help
	  Please submit a patch to add help text for this item.

config CONFIG_FEATURE_FDISK_ADVANCED
	bool "  Support expert mode"
	default n
	depends on CONFIG_FDISK && CONFIG_FEATURE_FDISK_WRITABLE
	help
	  Please submit a patch to add help text for this item.

config CONFIG_FREERAMDISK
	bool "freeramdisk"
	default n
	help
	  Please submit a patch to add help text for this item.

config CONFIG_FSCK_MINIX
	bool "fsck_minix"
	default n
	help
	  Please submit a patch to add help text for this item.

config CONFIG_MKFS_MINIX
	bool "mkfs_minix"
	default n
	help
	  Please submit a patch to add help text for this item.

comment "Minix filesystem support"
    depends on CONFIG_FSCK_MINIX || CONFIG_MKFS_MINIX

config CONFIG_FEATURE_MINIX2
	bool "  Support Minix fs v2 (fsck_minix/mkfs_minix)"
	default y
	depends on CONFIG_FSCK_MINIX || CONFIG_MKFS_MINIX
	help
	  Please submit a patch to add help text for this item.

config CONFIG_GETOPT
	bool "getopt"
	default n
	help
	  Please submit a patch to add help text for this item.

config CONFIG_HEXDUMP
	bool "hexdump"
	default n
	help
	  Please submit a patch to add help text for this item.

config CONFIG_HWCLOCK
	bool "hwclock"
	default n
	help
	  Please submit a patch to add help text for this item.

config CONFIG_FEATURE_HWCLOCK_LONGOPTIONS
	bool "  Support long options (--hctosys,...)"
	default n
	depends on CONFIG_HWCLOCK
	help
	  Please submit a patch to add help text for this item.

config CONFIG_LOSETUP
	bool "losetup"
	default n
	help
	  Please submit a patch to add help text for this item.

config CONFIG_MKSWAP
	bool "mkswap"
	default n
	help
	  Please submit a patch to add help text for this item.

config CONFIG_MORE
	bool "more"
	default n
	help
	  Please submit a patch to add help text for this item.

config CONFIG_FEATURE_USE_TERMIOS
	bool "  Use termios to manipulate the screen"
	default y
	depends on CONFIG_MORE
	help
	  Please submit a patch to add help text for this item.

comment "Common options for ls and more"
	depends on CONFIG_LS || CONFIG_MORE

config CONFIG_FEATURE_AUTOWIDTH
	bool "  Calculate terminal & column widths"
	default y
	depends on CONFIG_LS || CONFIG_MORE
	help
	  Please submit a patch to add help text for this item.

config CONFIG_PIVOT_ROOT
	bool "pivot_root"
	default n
	help
	  Please submit a patch to add help text for this item.

config CONFIG_RDATE
	bool "rdate"
	default n
	help
	  Please submit a patch to add help text for this item.

config CONFIG_SWAPONOFF
	bool "swaponoff"
	default n
	help
	  Please submit a patch to add help text for this item.

config CONFIG_MOUNT
	bool "mount"
	default n
	help
	  Please submit a patch to add help text for this item.

config CONFIG_NFSMOUNT
	bool "  Support mounting nfs file systems"
	default n
	depends on CONFIG_MOUNT
	help
	  Please submit a patch to add help text for this item.

config CONFIG_UMOUNT
	bool "umount"
	default n
	help
	  Please submit a patch to add help text for this item.

config CONFIG_FEATURE_MOUNT_FORCE
	bool "  Support forced filesystem unmounting"
	default n
	depends on CONFIG_UMOUNT
	help
	  Please submit a patch to add help text for this item.

comment "Common options for mount/umount"
	depends on CONFIG_MOUNT || CONFIG_UMOUNT

config CONFIG_FEATURE_MOUNT_LOOP
	bool "  Support for loop devices"
	default n
	depends on CONFIG_MOUNT || CONFIG_UMOUNT
	help
	  Please submit a patch to add help text for this item.

config CONFIG_FEATURE_MTAB_SUPPORT
	bool "  Support for a real /etc/mtab (instead of /proc/mounts)"
	default n
	depends on CONFIG_MOUNT || CONFIG_UMOUNT
	help
	  Please submit a patch to add help text for this item.

endmenu
```
